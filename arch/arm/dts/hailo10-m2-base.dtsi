// SPDX-License-Identifier: GPL-2.0
/*
 * base dts file for Hailo10-M.2 board.
 *
 * Copyright (c) 2019-2024 Hailo Technologies Ltd. All rights reserved.
 */

#include "hailo10-base.dtsi"
#include "hailo15_ddr_configuration.dtsi"
#include "hailo15_ddr_MT53E2G32D4DE-046_regconfig_8GB.dtsi"

&hailo_boot_info {
	ddr_config {
		f2_frequency = <2133000000>;
	};
};

&i2c_1 {
    status = "okay";
};
