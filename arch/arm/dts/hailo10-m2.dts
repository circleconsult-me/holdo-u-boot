// SPDX-License-Identifier: GPL-2.0
/*
 * dts file for Hailo10-M.2 board.
 *
 * Copyright (c) 2019-2024 Hailo Technologies Ltd. All rights reserved.
 */
#include "hailo10-m2-base.dtsi"

&qspi {
    status = "disabled";
};
