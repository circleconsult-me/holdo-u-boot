// SPDX-License-Identifier: GPL-2.0
/*
 * dts file for Hailo15 SoC
 *
 * Copyright (c) 2019-2023 Hailo Technologies Ltd. All rights reserved.
 */

//# The start of this is the copy of "hailo15-sbc.dts"

#include "hailo15-base.dtsi"
#include "hailo15_ddr_configuration.dtsi"
//#include "hailo15_ddr_MT53E512M32D1-046_regconfig_2GB.dtsi"
//#include "hailo15_ddr_MT53E2G32D4DE-046_regconfig_8GB.dtsi"
#include "hailo15_ddr_MT53E1G32D2FW-046_regconfig_ca_odtb_pu_4GB.dtsi"
