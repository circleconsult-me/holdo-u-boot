## board/hailo/hailo10-m2-devel/Kconfig
```kconfig
if TARGET_HAILO10_M2_DEVEL

config SYS_BOARD
	default "hailo10-m2-devel"

config SYS_VENDOR
	default "hailo"

config SYS_CONFIG_NAME
	default "hailo10-m2-devel"
	help
	  This option contains information about board configuration name.
	  Based on this option include/configs/<CONFIG_SYS_CONFIG_NAME>.h header
	  will be used for board configuration.

endif
```

## board/hailo/hailo10-m2/Kconfig
```kconfig
if TARGET_HAILO10_M2

config SYS_BOARD
	default "hailo10-m2"

config SYS_VENDOR
	default "hailo"

config SYS_CONFIG_NAME
	default "hailo10-m2"
	help
	  This option contains information about board configuration name.
	  Based on this option include/configs/<CONFIG_SYS_CONFIG_NAME>.h header
	  will be used for board configuration.

endif
```

## board/hailo/hailo15l-oregano/Kconfig
```kconfig
if TARGET_HAILO15L_OREGANO

config SYS_BOARD
	default "hailo15l-oregano"

config SYS_VENDOR
	default "hailo"

config SYS_CONFIG_NAME
	default "hailo15l-oregano"
	help
	  This option contains information about board configuration name.
	  Based on this option include/configs/<CONFIG_SYS_CONFIG_NAME>.h header
	  will be used for board configuration.

endif
```

## board/hailo/hailo15l-veloce/Kconfig
```kconfig
if TARGET_HAILO15L_VELOCE

config SYS_BOARD
	default "hailo15l-veloce"

config SYS_VENDOR
	default "hailo"

config SYS_CONFIG_NAME
	default "hailo15l-veloce"

endif
```

## board/hailo/holdo-hailo15/Kconfig
```kconfig
if TARGET_HOLDO_HAILO15

config SYS_BOARD
    default "holdo-hailo15"

config SYS_VENDOR
    default "hailo"

config SYS_CONFIG_NAME
    default "holdo-hailo15"

endif
```

## configs/hailo15_veloce_defconfig
```kconfig
CONFIG_ARM=y
CONFIG_ARCH_HAILO=y
CONFIG_TARGET_HAILO15_VELOCE=y
CONFIG_DEFAULT_DEVICE_TREE="hailo15-veloce"
# CONFIG_AUTOBOOT is not set
```

## configs/hailo15l_oregano_defconfig
```kconfig
CONFIG_ARM=y
CONFIG_ARCH_HAILO=y
CONFIG_TARGET_HAILO15L_OREGANO=y
CONFIG_DEFAULT_DEVICE_TREE="hailo15l-oregano"
CONFIG_SPI_FLASH_STMICRO=y
# CONFIG_ENV_IS_IN_MMC is not set
# CONFIG_SPL_ENV_IS_IN_MMC is not set
CONFIG_SPL_ENV_IS_NOWHERE=y
CONFIG_ENV_IS_NOWHERE=y
```

## configs/hailo15l_veloce_defconfig
```kconfig
CONFIG_ARM=y
CONFIG_ARCH_HAILO=y
CONFIG_TARGET_HAILO15L_VELOCE=y
CONFIG_DEFAULT_DEVICE_TREE="hailo15l-veloce"
# CONFIG_AUTOBOOT is not set
# CONFIG_ENV_IS_IN_MMC is not set
# CONFIG_SPL_ENV_IS_IN_MMC is not set
CONFIG_SPL_ENV_IS_NOWHERE=y
CONFIG_ENV_IS_NOWHERE=y
```

## configs/holdo_hailo15_defconfig
```kconfig
CONFIG_ARM=y
CONFIG_ARCH_HAILO=y
CONFIG_TARGET_HOLDO_HAILO15=y
CONFIG_DEFAULT_DEVICE_TREE="holdo-hailo15"
CONFIG_SPI_FLASH_ISSI=y
CONFIG_SPI_FLASH_WINBOND=y
CONFIG_SPI_FLASH_MACRONIX=y
```
